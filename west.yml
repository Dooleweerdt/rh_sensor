## west.yml
```yaml
# Copyright (c) 2021 Nordic Semiconductor ASA
# SPDX-License-Identifier: Apache-2.0

manifest:
  self:
    west-commands: scripts/west-commands.yml

  remotes:
    - name: zephyr-upstream
      url-base: https://github.com/zephyrproject-rtos
    - name: zephyr-downstream
      url-base: https://github.com/Dooleweerdt
    - name: mcuboot-remote
      url-base: https://github.com/mcu-tools

  projects:
    - name: zephyr
      remote: zephyr-downstream
      revision: 3568e1b6d5cdd51a6b964a2a1d6d29200fea2056 #v4.3.0
      import:
        # By using name-allowlist we can clone only the modules that are
        # strictly needed by the application.
        name-allowlist:
          - cmsis_6    # required by the ARM port for Cortex-M
          - mbedtls
          - zcbor
          - littlefs
          - hal_nordic # required by the custom_plank board (Nordic based)
          - hal_stm32  # required by the nucleo_f302r8 board (STM32 based)
          - hal_espressif # required by the esp32 board (Espressif based)

    - name: mcuboot
      remote: mcuboot-remote
      revision: v2.3.0-rc1
      path: bootloader/mcuboot

    - name: zephyr-lang-rust
      remote: zephyr-downstream
      revision: esp32c3_support
      path: modules/lang/rust
```
